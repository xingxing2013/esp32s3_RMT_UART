## components/rmt_soft_uart/Kconfig
```kconfig
menu "RMT Soft UART"

config RMT_SOFT_UART_RUN_TESTS
    bool "Run on-target unit tests at boot"
    default n
    help
        上电先跑 codec / ring 的 Unity 用例。

config RMT_SOFT_UART_SELFTEST
    bool "Run 3-channel loopback selftest at boot"
    default n
    depends on !RMT_SOFT_UART_RUN_TESTS
    help
        上电跑 3 路回环自测，结果打印到控制台。

config RMT_SOFT_UART_CH0_TX_GPIO
    int "CH0 TX GPIO"
    default 42
config RMT_SOFT_UART_CH0_RX_GPIO
    int "CH0 RX GPIO"
    default 41
config RMT_SOFT_UART_CH1_TX_GPIO
    int "CH1 TX GPIO"
    default 40
config RMT_SOFT_UART_CH1_RX_GPIO
    int "CH1 RX GPIO"
    default 39
config RMT_SOFT_UART_CH2_TX_GPIO
    int "CH2 TX GPIO"
    default 38
config RMT_SOFT_UART_CH2_RX_GPIO
    int "CH2 RX GPIO"
    default 37
config RMT_SOFT_UART_DEMO_BAUD
    int "Demo baud rate"
    default 115200

config SU_DIAG_IRQ_ONLY
    bool "Only start the extra interrupt, skip load test"
    default n
    depends on SU_DIAG_ENABLE

config SU_DIAG_ENABLE
    bool "Run 3-channel load test at boot (diagnostics)"
    default n
    select FREERTOS_GENERATE_RUN_TIME_STATS

config SU_DIAG_SECONDS
    int "Load test duration (seconds)"
    default 10
    depends on SU_DIAG_ENABLE

config SU_DIAG_BAUD
    int "Load test baud rate"
    default 1000000
    depends on SU_DIAG_ENABLE

config SU_DIAG_IRQ_KHZ
    int "Extra GPTimer interrupt rate (kHz, 0 = off)"
    default 0
    depends on SU_DIAG_ENABLE

config SU_DIAG_HOG_PERCENT
    int "Extra CPU hog duty cycle (%, 0 = off)"
    default 0
    depends on SU_DIAG_ENABLE

endmenu
```
